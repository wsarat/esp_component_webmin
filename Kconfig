## Kconfig
```kconfig
menu "webmin Component Configuration"

    config WEBMIN_WIFI_SSID
        string "Default WiFi SSID"
        default "myssid"
        help
            Default SSID (network name).

    config WEBMIN_WIFI_PASSWORD
        string "Default WiFi Password"
        default "mypassword"
        help
            Default WiFi password (WPA or WPA2).

    choice ESP_WIFI_SCAN_AUTH_MODE_THRESHOLD
        prompt "WiFi Scan auth mode threshold"
        default ESP_WIFI_AUTH_WPA2_PSK
        help
            The weakest authmode to accept in the scan mode.
            This value defaults to ESP_WIFI_AUTH_WPA2_PSK in case password is present and ESP_WIFI_AUTH_OPEN is used.
            Please select ESP_WIFI_AUTH_WEP/ESP_WIFI_AUTH_WPA_PSK in case AP is operating in WEP/WPA mode.

        config ESP_WIFI_AUTH_OPEN
            bool "OPEN"
        config ESP_WIFI_AUTH_WEP
            bool "WEP"
        config ESP_WIFI_AUTH_WPA_PSK
            bool "WPA PSK"
        config ESP_WIFI_AUTH_WPA2_PSK
            bool "WPA2 PSK"
        config ESP_WIFI_AUTH_WPA_WPA2_PSK
            bool "WPA/WPA2 PSK"
        config ESP_WIFI_AUTH_WPA3_PSK
            bool "WPA3 PSK"
        config ESP_WIFI_AUTH_WPA2_WPA3_PSK
            bool "WPA2/WPA3 PSK"
        config ESP_WIFI_AUTH_WAPI_PSK
            bool "WAPI PSK"
    endchoice

    config WEBMIN_WIFI_MAXIMUM_RETRY
        int "Wifi Maximum retry"
        default 10
        help
            Set the Maximum retry to avoid station reconnecting to the AP unlimited when the AP is really inexistent.

    config WEBMIN_HTTP_PORT
        int "webmin server port"
        default 8081
        help
            Port

    config WEBMIN_BASIC_USERNAME
        string "webmin basic auth username"
        default "admin"
        help
            Default Username

    config WEBMIN_BASIC_PASSWORD
        string "webmin basic auth password"
        default "password"
        help 
            Default Password

endmenu
```
